## boards/arm/cleaver/Kconfig
```kconfig
# SPDX-License-Identifier: MIT

config BOARD_ENABLE_DCDC
	bool "Enable DCDC mode"
	select SOC_DCDC_NRF52X
	default y
	depends on BOARD_ICEBREAKER

config ZMK_ACTIVITY_TRIGGER_KEYS
	bool "Enable keyboard activity trigger"
	default y
	help
	  Enable activity trigger on key press events

config ZMK_ACTIVITY_TRIGGER_TIME_MS
	int "Activity trigger timeout in milliseconds"
	default 100
	help
	  The time in milliseconds after which an activity trigger is fired
```

## boards/arm/cleaver/Kconfig.board
```kconfig
# Copyright (c) 2020 The ZMK Contributors
# SPDX-License-Identifier: MIT

config BOARD_CLEAVER
	bool "cleaver"
```

## boards/arm/cleaver/Kconfig.defconfig
```kconfig
# Copyright (c) 2020 The ZMK Contributors
# SPDX-License-Identifier: MIT

if BOARD_CLEAVER

config ZMK_KEYBOARD_NAME
	default "cleaver"


# 72MHz system clock
CONFIG_SYS_CLOCK_HW_CYCLES_PER_SEC=72000000


config USB_DEVICE_STACK
	default y


config ZMK_USB
	default y

config I2C
	default y

endif # BOARD_CLEAVER
```

## boards/arm/cleaver/cleaver_defconfig
```kconfig
# SPDX-License-Identifier: MIT

CONFIG_SOC_SERIES_STM32F4X=y
CONFIG_SOC_STM32F411XE=y


CONFIG_BOARD_CLEAVER=y

# Enable MPU
CONFIG_ARM_MPU=y

# Enable HW stack protection
CONFIG_HW_STACK_PROTECTION=y

# Serial Drivers
CONFIG_SERIAL=y
CONFIG_UART_INTERRUPT_DRIVEN=y
CONFIG_CONSOLE=y
CONFIG_UART_CONSOLE=y


# Clock configuration
CONFIG_CLOCK_CONTROL=y

# enable pin controller
CONFIG_PINCTRL=y

# Enable GPIO
CONFIG_GPIO=y

# Only enable LED_GPIO if you have GPIO LEDs configured in DTS
# CONFIG_LED=y
# CONFIG_LED_GPIO=y

CONFIG_REBOOT=y

# Enable necessary configurations for USB to work
CONFIG_MPU_ALLOW_FLASH_WRITE=y
CONFIG_NVS=y
CONFIG_SETTINGS_NVS=y
CONFIG_FLASH=y
CONFIG_FLASH_PAGE_LAYOUT=y
CONFIG_FLASH_MAP=y


# USB Configuration
CONFIG_USB_DEVICE_STACK=y
CONFIG_USB_DEVICE_MANUFACTURER="ZMK Project"
CONFIG_USB_DEVICE_PRODUCT="Cleaver Keyboard"
CONFIG_USB_DEVICE_VID=0x1D50
CONFIG_USB_DEVICE_PID=0x615E

# Windows Battery Reporting Fix
CONFIG_BT_GATT_ENFORCE_SUBSCRIPTION=n

# Settings configuration
CONFIG_SETTINGS=y

# Turn on logging, and set ZMK logging to debug output
# CONFIG_LOG=y
# CONFIG_ZMK_USB_LOGGING=y
# CONFIG_ZMK_LOG_LEVEL_DBG=y
# CONFIG_I2C_LOG_LEVEL_DBG=y
# CONFIG_SENSOR_LOG_LEVEL_DBG=y
```

## boards/arm/cleaver/icebreaker_defconfig
```kconfig
# SPDX-License-Identifier: MIT

CONFIG_SOC_SERIES_STM32F4X=y
CONFIG_SOC_STM32F411XE=y


CONFIG_BOARD_CLEAVER=y

# Enable MPU
CONFIG_ARM_MPU=y

# Enable GPIO
CONFIG_GPIO=y
CONFIG_LED=y
CONFIG_LED_GPIO=y

CONFIG_REBOOT=y


CONFIG_MPU_ALLOW_FLASH_WRITE=y
CONFIG_NVS=y
CONFIG_SETTINGS_NVS=y
CONFIG_FLASH=y
CONFIG_FLASH_PAGE_LAYOUT=y
CONFIG_FLASH_MAP=y




CONFIG_PINCTRL=y

# Windows Battery Reporting Fix
CONFIG_BT_GATT_ENFORCE_SUBSCRIPTION=n

# Turn on logging, and set ZMK logging to debug output
# CONFIG_LOG=y
# CONFIG_ZMK_USB_LOGGING=y
# CONFIG_ZMK_LOG_LEVEL_DBG=y
# CONFIG_I2C_LOG_LEVEL_DBG=y
# CONFIG_SENSOR_LOG_LEVEL_DBG=y
```

## boards/arm/icebreaker/Kconfig.defconfig
```kconfig
# Copyright (c) 2020 The ZMK Contributors
# SPDX-License-Identifier: MIT

if BOARD_ICEBREAKER

config ZMK_KEYBOARD_NAME
	default "icebreaker"

config USB_DEVICE_STACK
	default y

config ZMK_USB
	default y

config I2C
	default y

endif # BOARD_ICEBREAKER
```

## boards/arm/serene65/Kconfig
```kconfig
# Serene65 board configuration

# Copyright (c) 2025 Matthijs Muller
# SPDX-License-Identifier: MIT

# Matrix driver configuration options
config ZMK_KSCAN_MATRIX_DRIVER
	bool "Enable matrix driver for hall effect sensors"
	default y
	help
	  This option enables the matrix driver for hall effect sensors.

# Hall effect driver configuration options

config ZMK_HALL_EFFECT
	bool "ZMK Hall Effect Support"
	depends on ZMK_KSCAN_MATRIX_DRIVER
	default n
	help
	  This option enables hall effect support for ZMK.

config ZMK_HALL_EFFECT_CALIBRATION
	bool "ZMK Hall Effect Calibration Support"
	depends on ZMK_HALL_EFFECT
	default n
	help
	  This option enables calibration support for hall effect sensors.

config ZMK_HALL_EFFECT_RAPID_TRIGGER
	bool "ZMK Hall Effect Rapid Trigger Support"
	depends on ZMK_HALL_EFFECT
	default n
	help
	  This option enables rapid trigger support for hall effect sensors.


if BOARD_SERENE65
menu "Hall Effect Configuration"

config HALL_EFFECT_LOG_LEVEL
	int "Hall Effect Log Level"
	default 4
	range 0 4
	help
	  0=OFF, 1=ERROR, 2=WARN, 3=INFO, 4=DEBUG

endmenu
endif 
```

## boards/arm/serene65/Kconfig.soc
```kconfig
# Serene65 SOC configuration

# Copyright (c) 2025 Matthijs Muller
# SPDX-License-Identifier: MIT

config SOC_STM32F411XE
    select SOC_SERIES_STM32F4X
    select CPU_CORTEX_M4
    select CPU_HAS_FPU 
```

## boards/arm/serene65/dts/bindings/hall_effect_kscan.yaml
```yaml
# Copyright (c) 2025 Matthijs Muller
# SPDX-License-Identifier: MIT

description: Custom Hall Effect KSCAN device driver

compatible: "hall_effect_kscan"

include: kscan.yaml

properties:
  status:
    required: true 
```

## boards/arm/serene65/dts/bindings/worldsemi,ws2812-custom.yaml
```yaml
description: Custom GPIO-based WS2812 LED strip controller

compatible: "worldsemi,ws2812-custom"

include: base.yaml

properties:
  in-gpios:
    type: phandle-array
    required: true
    description: |
      GPIO to use for bit-banged data output to the LED strip.

  chain-length:
    type: int
    required: true
    description: |
      Number of LEDs in the daisy-chained strip.

  color-mapping:
    type: array
    required: true
    description: |
      Color mapping for the LED strip. Specifies the order that
      LED color information should be sent. The mapping is for
      a single LED. Values should be chosen from the LED_COLOR_ID
      defines in dt-bindings/led/led.h.

      For example, a strip that uses a GRB order would use
      <LED_COLOR_ID_GREEN LED_COLOR_ID_RED LED_COLOR_ID_BLUE>. 
```

## boards/arm/serene65/dts/bindings/worldsemi,ws2812-pwm-dma.yaml
```yaml
description: PWM with DMA-based WS2812 LED strip controller

compatible: "worldsemi,ws2812-pwm-dma"

include: base.yaml

properties:
  chain-length:
    type: int
    required: true
    description: |
      Number of LEDs in the daisy-chained strip.

  pwm-channel:
    type: phandle-array
    required: true
    specifier-space: pwm
    description: |
      PWM channel to use for sending WS2812 data.
      For STM32, this should be a timer channel capable of 
      PWM output with DMA support.

  dma-channel:
    type: int
    required: true
    description: |
      DMA channel to use for transferring LED data to PWM.

  dma-slot:
    type: int
    required: true
    description: |
      DMA request slot to use for the PWM timer.

  color-mapping:
    type: array
    required: true
    description: |
      Color mapping for the LED strip. Specifies the order that
      LED color information should be sent. The mapping is for
      a single LED. Values should be chosen from the LED_COLOR_ID
      defines in dt-bindings/led/led.h.

      For example, a strip that uses a GRB order would use
      <LED_COLOR_ID_GREEN LED_COLOR_ID_RED LED_COLOR_ID_BLUE>. 
```

## boards/arm/serene65/dts/bindings/worldsemi,ws2812-pwm.yaml
```yaml
# Copyright (c) 2024 Matthijs Muller
# SPDX-License-Identifier: Apache-2.0

description: WS2812 LED strip driven with PWM/DMA

compatible: "worldsemi,ws2812-pwm"

include: led-controller.yaml

properties:
  chain-length:
    type: int
    required: true
    description: |
      Number of LEDs in the strip

  pwms:
    type: phandle-array
    required: true
    description: |
      PWM connection information for the WS2812 LED strip.
      Specifies the controller, channel, period and flags as specified by the
      PWM controller API.

  color-mapping:
    type: array
    required: true
    description: |
      Color mapping for the LED strip.
      Specifies the order of colors (e.g., RGB, GRB) using the LED_COLOR_ID_*
      macros defined in dt-bindings/led/led.h.
      LED_COLOR_ID_RED, LED_COLOR_ID_GREEN, LED_COLOR_ID_BLUE are the
      supported values. 
```

## boards/arm/serene65/dts/bindings/zmk,kscan.yaml
```yaml
# Copyright (c) 2025 Matthijs Muller
# SPDX-License-Identifier: MIT

description: ZMK KSCAN Handler

compatible: "zmk,kscan"

include: kscan.yaml

properties:
  label:
    type: string
    description: Human readable string describing the device. 
```

## boards/arm/serene65/dts/bindings/zmk,matrix-hall-effect.yaml
```yaml
# Copyright (c) 2025 Matthijs Muller
# SPDX-License-Identifier: MIT

description: ZMK Hall Effect Matrix driver

compatible: "zmk,matrix-hall-effect"

include: base.yaml

properties:
  status:
    type: string
    enum:
      - "okay"
      - "disabled"
    description: Whether the driver is enabled or disabled.
  
  label:
    type: string
    description: Human readable string describing the device.
    
  diode-direction:
    type: string
    enum:
      - "row2col"
      - "col2row"
    description: Diode direction. 
```

## boards/arm/serene65/kconfig.board
```kconfig
# Serene65 board configuration

# Copyright (c) 2025 Matthijs Muller
# SPDX-License-Identifier: MIT

config BOARD_SERENE65
    bool "Serene65"
	depends on SOC_STM32F411XE
```

## boards/arm/serene65/kconfig.defconfig
```kconfig
# Serene65 board configuration

# Copyright (c) 2025 Matthijs Muller
# SPDX-License-Identifier: MIT

if BOARD_SERENE65

config BOARD
    default "serene65"

config ZMK_KEYBOARD_NAME
    default "Serene65"

config ZMK_RGB_UNDERGLOW
    select WS2812_STRIP
    select SPI

config ZMK_USB
    default y

# Enable hall effect matrix driver
config ZMK_KSCAN_MATRIX_DRIVER
    default y

# Enable hall effect sensor support
config ZMK_HALL_EFFECT
    default y
    depends on ZMK_KSCAN_MATRIX_DRIVER

# Enable hall effect sensor calibration
config ZMK_HALL_EFFECT_CALIBRATION
    default y
    depends on ZMK_HALL_EFFECT

# Enable hall effect rapid trigger mode
config ZMK_HALL_EFFECT_RAPID_TRIGGER
    default y
    depends on ZMK_HALL_EFFECT

# Enable ADC for hall effect sensors
config ADC
    default y

# Enable settings for calibration storage
config SETTINGS
    default y

config SETTINGS_RUNTIME
    default y

if USB

config USB_DEVICE_STACK
    default y

config USB_DEVICE_MANUFACTURER
    default "ZMK Project"

config USB_DEVICE_PRODUCT
    default "Serene65"

config USB_DEVICE_VID
    default 0x1D50

config USB_DEVICE_PID
    default 0x615E

endif # USB

if ZMK_RGB_UNDERGLOW

config WS2812_STRIP
    default y
    
config SPI
    default y

endif # ZMK_RGB_UNDERGLOW

endif # BOARD_SERENE65
```

## boards/arm/serene65/serene65_defconfig
```kconfig
# Copyright (c) 2021 The ZMK Contributors
# SPDX-License-Identifier: MIT

# Board configuration
CONFIG_BOARD_SERENE65=y

# SOC configuration

CONFIG_SOC_SERIES_STM32F4X=y
CONFIG_SOC_STM32F411XE=y

# 72MHz system clock
CONFIG_SYS_CLOCK_HW_CYCLES_PER_SEC=72000000

# Enable GPIO
CONFIG_GPIO=y

# Enable pinctrl
CONFIG_PINCTRL=y

# Enable RGB underglow
CONFIG_ZMK_RGB_UNDERGLOW=y
CONFIG_WS2812_STRIP=y
CONFIG_LED_STRIP=y
CONFIG_WS2812_STRIP_SPI=n
CONFIG_SPI=n
CONFIG_PWM=y
CONFIG_DMA=y

# Enable ADC
CONFIG_ADC=y
CONFIG_ADC_STM32=y

# Enable settings
CONFIG_SETTINGS=y
CONFIG_SETTINGS_RUNTIME=y
CONFIG_SETTINGS_NVS=y

# Enable hall effect driver
CONFIG_ZMK_HALL_EFFECT=y
CONFIG_ZMK_HALL_EFFECT_CALIBRATION=y
CONFIG_ZMK_HALL_EFFECT_RAPID_TRIGGER=y

# Enable matrix driver
CONFIG_ZMK_KSCAN_MATRIX_DRIVER=y

CONFIG_ISR_STACK_SIZE=1024

# clock configuration
CONFIG_CLOCK_CONTROL=y

CONFIG_ZMK_USB=y

CONFIG_ZMK_RGB_UNDERGLOW_EXT_POWER=n

# Enable MPU
CONFIG_ARM_MPU=y

# Enable HW stack protection
CONFIG_HW_STACK_PROTECTION=y

# Enable UART console
CONFIG_SERIAL=y
CONFIG_CONSOLE=y
CONFIG_UART_CONSOLE=y

# Enable USB
CONFIG_USB_DEVICE_STACK=y
CONFIG_USB_DEVICE_MANUFACTURER="Matthijs Muller"
CONFIG_USB_DEVICE_PRODUCT="Serene65"
CONFIG_USB_DEVICE_VID=0x1D50
CONFIG_USB_DEVICE_PID=0x615E
CONFIG_USB_DEVICE_HID=y
CONFIG_USB_NUMOF_EP_WRITE_RETRIES=10

# Configure hardware critical sections
CONFIG_REBOOT=y

# Enable flash storage
CONFIG_FLASH=y
CONFIG_FLASH_MAP=y
CONFIG_NVS=y

# Configure MPU to allow USB
CONFIG_MPU_ALLOW_FLASH_WRITE=y

# Logging level
CONFIG_ZMK_LOG_LEVEL_INF=y
CONFIG_USB_DEVICE_LOG_LEVEL_ERR=y
CONFIG_UART_LOG_LEVEL_WRN=y
CONFIG_PRINTK=y
```

## boards/arm/serene65/src/Kconfig
```kconfig
# Hall effect driver configuration options

config ZMK_HALL_EFFECT
	bool "Hall effect sensor support"
	default y
	depends on ADC
	depends on SETTINGS
	help
	  This option enables the hall effect sensor driver for ZMK.

config ZMK_HALL_EFFECT_CALIBRATION
	bool "Hall effect sensor calibration"
	default y
	depends on ZMK_HALL_EFFECT
	help
	  This option enables calibration for hall effect sensors.

config ZMK_HALL_EFFECT_RAPID_TRIGGER
	bool "Hall effect rapid trigger mode"
	default y
	depends on ZMK_HALL_EFFECT
	help
	  This option enables rapid trigger mode for hall effect sensors. 
```

## boards/shields/tft/kconfig.defconfig
```kconfig
config ZMK_KEYBOARD_NAME
	default "tft"


config I2C
    default y

config ZMK_STUDIO
    default y if SHIELD_TFT
```

## boards/shields/tft/kconfig.shield
```kconfig
# Copyright (c) 2025 Matthijs Muller

config SHIELD_TFT
    bool "TFT keyboard shield"
```

## config/west.yml
```yaml
manifest:
  remotes:
    - name: zmkfirmware
      url-base: https://github.com/zmkfirmware

  projects:
    - name: zmk
      remote: zmkfirmware
      revision: main
      import: app/west.yml
  self:
    path: config
    
manifest:
  remotes:
    - name: zmkfirmware
      url-base: https://github.com/zmkfirmware
    - name: smollchungus
      url-base: https://github.com/smollchungus

  projects:
    - name: zmk
      remote: zmkfirmware
      revision: main
      import: app/west.yml
    - name: hammerbeam-slideshow
      remote: gpeye
      revision: main
    - name: zmk-nice-oled
      remote: mctechnology17
      revision: main
    - name: nice-view-elemental
      remote: kevinpastor
      revision: main
    - name: nice-view-gem
      remote: m165437
      revision: main
    - name: zmk-shield-nice-view-cats
      remote: s6t
      revision: main
    - name: nice-view-battery
      remote: infely
      revision: main
  self:
    path: config
```
