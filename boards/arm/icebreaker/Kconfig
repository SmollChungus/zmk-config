## boards/arm/icebreaker/Kconfig
```kconfig
# SPDX-License-Identifier: MIT

config BOARD_ENABLE_DCDC
	bool "Enable DCDC mode"
	select SOC_DCDC_NRF52X
	default y
	depends on BOARD_ICEBREAKER

CONFIG_ZMK_RGB_UNDERGLOW_BRT_START 20
```

## boards/arm/icebreaker/Kconfig.board
```kconfig
# Copyright (c) 2020 The ZMK Contributors
# SPDX-License-Identifier: MIT

config BOARD_ICEBREAKER
	bool "Icebreaker"
	depends on SOC_NRF52840_QIAA
```
